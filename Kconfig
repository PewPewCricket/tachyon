## arch/Kconfig
```kconfig
menu "Architecture"

    choice
        prompt "Target Architecture"
        default ARCH_X86_64

        config ARCH_X86_64
            bool "x86_64"

    endchoice

    if ARCH_X86_64
        source "arch/x86_64/Kconfig"
    endif

endmenu
```

## arch/x86_64/Kconfig
```kconfig
menu "Debugging"
    config DEBUG_PORT_E9
        bool "Enable logging to port e9 for VM debugging."
        depends on ARCH_X86_64
        default n
        help
            Enable debug logging to port 0xe9.
            Supported by QEMU and Bochs.

endmenu
```

## src/arch/Kconfig
```kconfig
menu "Architecture"

    choice
        prompt "Target Architecture"
        default ARCH_X86_64

        config ARCH_X86_64
            bool "x86_64"

    endchoice

    if ARCH_X86_64
        rsource "x86_64/Kconfig"
    endif

endmenu
```

## src/init/Kconfig
```kconfig
menu "Demo"
    config FUN_PRINT_SILLY
        bool "Print a line across the screen on boot."
        default n

endmenu
```
